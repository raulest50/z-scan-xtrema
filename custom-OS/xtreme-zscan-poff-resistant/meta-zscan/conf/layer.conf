## custom-OS/xtreme-zscan-poff-resistant/meta-zscan/conf/layer.conf
```bitbake
BBPATH .= ":${LAYERDIR}"
BBFILES += "${LAYERDIR}/recipes-*/*/*.bb ${LAYERDIR}/recipes-*/*/*.bbappend ${LAYERDIR}/../xtreme-zscan-poff-resistant.bb"
BBFILE_COLLECTIONS += "zscan"
BBFILE_PATTERN_zscan := "^${@os.path.dirname(d.getVar('LAYERDIR'))}/"
BBFILE_PRIORITY_zscan = "10"
LAYERSERIES_COMPAT_zscan = "scarthgap"
LAYERDEPENDS_zscan = "core openembedded-layer networking-layer webserver"
WKS_SEARCH_PATH:append := ":${LAYERDIR}/wic"
```
